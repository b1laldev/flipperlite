## firmware/main/Kconfig.projbuild
```kconfig
menu "FlipperLite hardware"

config FLITE_OLED_SDA
    int "SSD1306 SDA GPIO"
    default 8

config FLITE_OLED_SCL
    int "SSD1306 SCL GPIO"
    default 9

config FLITE_OLED_ADDR
    hex "SSD1306 I2C address"
    range 0x3C 0x3D
    default 0x3C

config FLITE_PIN_UP
    int "Up button GPIO"
    default 4

config FLITE_PIN_DOWN
    int "Down button GPIO"
    default 5

config FLITE_PIN_LEFT
    int "Left button GPIO"
    default 6

config FLITE_PIN_RIGHT
    int "Right button GPIO"
    default 7

config FLITE_PIN_OK
    int "Ok button GPIO"
    default 15

config FLITE_PIN_BACK
    int "Back button GPIO"
    default 16

config FLITE_AP_SSID
    string "SoftAP SSID prefix"
    default "FlipperLite"

config FLITE_LONG_PRESS_MS
    int "Long press threshold (ms)"
    default 600
    range 200 2000

endmenu
```
